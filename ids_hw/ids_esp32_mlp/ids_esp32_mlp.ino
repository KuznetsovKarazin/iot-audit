/*
 * IDS Embedded — MLP INT8 (TFLite Micro)
 * Board  : ESP32-C3 SuperMini  (RISC-V 160 MHz, 400 KB SRAM)
 * Model  : mlp.h               (student's quantized model, 13344 bytes)
 * Dataset: TON_IoT binary      F1=0.9959  ROC-AUC=0.9993
 * Size   : 121.69 KB → 13.03 KB INT8  (9.34x compression)
 * Wokwi  : ~5.25 µs latency    1668 B arena
 *
 * This is the EXACT same model tested by the student on Wokwi.
 * Hardware results here are directly comparable to Wokwi simulation.
 *
 * Library: espressif/esp-tflite-micro  (see platformio.ini)
 * mlp.h  : g_mlp_model[]  13344 bytes, generated by quantization_export.py
 *
 * Quantization parameters (calibrated on 200 TON_IoT samples):
 *   input  scale=0.0078740  zero_point=-1
 *   output scale=0.00390625 zero_point=-128
 */

#include <Arduino.h>
#include "mlp.h"

#include "tensorflow/lite/micro/micro_interpreter.h"
#include "tensorflow/lite/micro/micro_mutable_op_resolver.h"
#include "tensorflow/lite/schema/schema_generated.h"

/* ── Configuration ──────────────────────────────────────────────────── */
#define N_FEATURES      95
#define TENSOR_ARENA_KB 48

#define INPUT_SCALE   0.0078740f
#define INPUT_ZP     (-1)
#define OUTPUT_SCALE  0.00390625f
#define OUTPUT_ZP    (-128)

/* ── Static allocations ─────────────────────────────────────────────── */
static uint8_t tensor_arena[TENSOR_ARENA_KB * 1024];

using MlpResolver = tflite::MicroMutableOpResolver<4>;
static MlpResolver resolver;
static const tflite::Model*      tfl_model    = nullptr;
static tflite::MicroInterpreter* interpreter  = nullptr;
static TfLiteTensor*             input_tensor = nullptr;
static TfLiteTensor*             output_tensor= nullptr;

/* ── Test samples — identical to Wokwi simulation ───────────────────── */
/* StandardScaler + OHE, 95 features, TON_IoT */

float sample_attack[N_FEATURES] = {
   1.23f, -0.45f,  2.10f,  3.85f,  0.39f, -0.10f,
   1.47f,  2.92f,  0.38f,  1.93f,  0.04f, -0.02f,
   0.08f,  0.04f, -0.03f,  0.02f,
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   0,0,0,0,0,0,0,0, 0,0,0,0,0,0,0
};

float sample_normal[N_FEATURES] = {
  -0.12f, -0.45f,  0.82f, -0.91f, -0.38f,  0.00f,
  -0.75f, -0.82f, -0.71f, -0.63f, -0.02f,  0.01f,
  -0.04f, -0.02f,  0.01f, -0.01f,
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   0,0,0,0,0,0,0,0, 0,0,0,0,0,0,0
};

/* ── Quantization helpers ───────────────────────────────────────────── */
static int8_t quantize(float x) {
  int q = (int)roundf(x / INPUT_SCALE) + INPUT_ZP;
  if (q < -128) q = -128;
  if (q >  127) q =  127;
  return (int8_t)q;
}

static float dequantize(int8_t q) {
  return (float)(q - OUTPUT_ZP) * OUTPUT_SCALE;
}

/* ── Setup ──────────────────────────────────────────────────────────── */
void setup() {
  Serial.begin(115200);
  delay(1000);

  Serial.println("READY");
  Serial.println("MODEL=MLP_TFLite_INT8");
  Serial.println("BOARD=ESP32-C3-SuperMini");
  Serial.println("F1=0.9959");
  Serial.println("ROC_AUC=0.9993");
  Serial.println("SIZE_KB=13.03");
  Serial.println("SRAM_LIMIT_BYTES=409600");

  tfl_model = tflite::GetModel(g_mlp_model);
  if (tfl_model->version() != TFLITE_SCHEMA_VERSION) {
    Serial.println("ERROR:schema_version_mismatch");
    while (true) {}
  }

  resolver.AddFullyConnected();
  resolver.AddRelu();
  resolver.AddLogistic();
  resolver.AddQuantize();

  static tflite::MicroInterpreter static_interpreter(
      tfl_model, resolver, tensor_arena, sizeof(tensor_arena));
  interpreter = &static_interpreter;

  if (interpreter->AllocateTensors() != kTfLiteOk) {
    Serial.println("ERROR:AllocateTensors_failed");
    while (true) {}
  }

  input_tensor  = interpreter->input(0);
  output_tensor = interpreter->output(0);

  if (input_tensor->type != kTfLiteInt8) {
    Serial.println("WARN:input_not_int8");
  }

  Serial.print("ARENA_USED_BYTES=");
  Serial.println(interpreter->arena_used_bytes());
  Serial.print("FREE_HEAP_START=");
  Serial.println(ESP.getFreeHeap());
  Serial.println("HEADER:label,pred,prob,latency_us,arena_bytes,correct");
}

/* ── Classify ───────────────────────────────────────────────────────── */
static void classify(float* features, const char* label, int expected) {
  for (int i = 0; i < N_FEATURES; i++) {
    input_tensor->data.int8[i] = quantize(features[i]);
  }

  unsigned long t0 = micros();
  if (interpreter->Invoke() != kTfLiteOk) {
    Serial.println("ERROR:invoke_failed");
    return;
  }
  unsigned long dt = micros() - t0;

  int8_t raw   = output_tensor->data.int8[0];
  float  prob  = dequantize(raw);
  int    pred  = (raw > OUTPUT_ZP) ? 1 : 0;
  size_t arena = interpreter->arena_used_bytes();
  int correct  = (pred == expected) ? 1 : 0;

  Serial.print(label);  Serial.print(",");
  Serial.print(pred);   Serial.print(",");
  Serial.print(prob, 4);Serial.print(",");
  Serial.print(dt);     Serial.print(",");
  Serial.print(arena);  Serial.print(",");
  Serial.println(correct);
}

void loop() {
  classify(sample_attack, "ATTACK", 1);
  classify(sample_normal, "NORMAL", 0);
  delay(2000);
}
